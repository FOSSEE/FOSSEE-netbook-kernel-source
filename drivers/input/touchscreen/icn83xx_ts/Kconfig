## drivers/input/touchscreen/icn83xx_ts/Kconfig
```kconfig
#
# ICN83XX capacity touch screen driver configuration
#
config TOUCHSCREEN_ICN83XX
	tristate "ICN83XX I2C Capacitive Touchscreen Input Driver Support"
	depends on ARCH_WMT
	default y
	help
	  Say Y here if you have an WMT based board with touchscreen
	  attached to it.

	  If unsure, say N.

	  To compile this driver as a module, choose M here: the
	  module will be called s_wmt_ts_icn83xx
```

## drivers/input/touchscreen/lw86x0_ts/Kconfig
```kconfig
config TOUCHSCREEN_LW86X0
        tristate "LW86X0 Touchscreen Driver"
        default y
        depends on ARCH_WMT
        ---help---
          Say Y here if you have an WMT based board with touchscreen
          attached to it.
          If unsure, say N.
          To compile this driver as a module, choose M here: the
          module will be called lw86x0_ts.
```

## drivers/input/touchscreen/ssd253x_ts/Kconfig
```kconfig
#
# SSD253x capacity touch screen driver configuration
#
config TOUCHSCREEN_SSD253X
	tristate "SSD253X I2C Touchscreen Input Driver Support"
	depends on ARCH_WMT
	default y
	help
	  Say Y here if you have an WMT based board with touchscreen
	  attached to it.

	  If unsure, say N.

	  To compile this driver as a module, choose M here: the
	  module will be called s_wmt_ts_ssd253x.
```

## drivers/media/dvb/raontech/Kconfig
```kconfig
#
# ISDBT config states
#

config ISDBT_RAONTECH_MTV
	tristate "RAONTECH based MTV receiver"
	depends on	WMT_SPISLAVE1_SUPPORT
	help
	  This allows ISDBT.
	  This module is designed for SPI or TSIF.
	  Select chipset and interface

menu "Raotech module components"

choice
	depends on ISDBT_RAONTECH_MTV && WMT_SPISLAVE1_SUPPORT
	prompt "chip"
	default ISDBT_MTV23x
	config ISDBT_MTV23x
		bool "MTV23x"
endchoice

endmenu
```

## drivers/mtk_wcn_bt/Kconfig
```kconfig
menu "MediaTek Bluetooth Chip Config"

config MTK_DISCRETE_BT
	tristate "MediaTek Discrete Bluetooth Chip Support"
	help
	  MTK discrete Bluetooth chip support (MT6622, MT6626)

config MTK_DISCRETE_BT_HW_CTL
	tristate "MediaTek Bluetooth Hardware Control driver"
	depends on MTK_DISCRETE_BT
	help
	  MTK BT hardware control driver for discrete Bluetooth chip

endmenu
```

## drivers/net/wireless/bcmdhd.1.88.45.x.cn/Kconfig
```kconfig
config BCMDHD
	tristate "Broadcom ap6474 for android4.4 wireless cards support"
	depends on MMC
	---help---
	  This module adds support for wireless adapters based on
	  Broadcom 4329/30 chipset.

config BCMDHD_FW_PATH
	depends on BCMDHD
	string "Firmware path"
	default "/system/etc/firmware/fw_bcmdhd.bin"
	---help---
	  Path to the firmware file.

config BCMDHD_NVRAM_PATH
	depends on BCMDHD
	string "NVRAM path"
	default "/system/etc/firmware/nvram_ap6476.txt"
	---help---
	  Path to the calibration file.

config BCMDHD_CONFIG_PATH
	depends on BCMDHD
	string "Config path"
	default "/system/etc/firmware/config.txt"
	---help---
	  Path to the driver configuration file.

config BCMDHD_WEXT
	bool "Enable WEXT support"
	depends on BCMDHD && CFG80211 = n
	select WIRELESS_EXT
	select WEXT_PRIV
	help
	  Enables WEXT support

choice
	depends on BCMDHD
	prompt "Interrupt type"
	---help---
	  Interrupt type
config BCMDHD_OOB
	depends on BCMDHD
	bool "Out-of-Band Interrupt"
	default y
	---help---
	  Interrupt from WL_HOST_WAKE.
config BCMDHD_SDIO_IRQ
	depends on  BCMDHD
	bool "In-Band Interrupt"
	---help---
	  Interrupt from SDIO DAT[1]
endchoice

choice
	depends on  BCMDHD
	prompt "Power saving mode in suspend"
	---help---
	  Power saving mode in suspend
config BCMDHD_PS0
	depends on BCMDHD_OOB
	bool "Keep power and WoWLAN enabled"
	default y
	---help---
	  Wi-Fi can keep connect with AP in suspend and wake up host if packets received.
	  WL_HOST_WAKE must be connected to the GPIO which can wake up host in suspend.
config BCMDHD_DISABLE_WOWLAN
	bool "Keep power but WoWLAN disabled"
	---help---
	  Wi-Fi can keep connect with AP in suspend
config BCMDHD_POWER_OFF_IN_SUSPEND
	bool "Power off"
	---help---
	  Wi-Fi would be powered down in suspend and powered on in resumed
endchoice
```

## drivers/net/wireless/mt5931/Kconfig
```kconfig
menuconfig MTK_MT5931_KK
	bool "MediaTek MT5931 Config for android4.4"
	help
	  Config MTK WLAN chip mt5931


config MTK_MT5931_WIFI_KK
	tristate "MT5931 Wi-Fi for android4.4"
	depends on MTK_MT5931_KK
	depends on MMC
	depends on IPV6
	select WIRELESS_EXT
	select WEXT_PRIV
	default y
	help
	  This module adds support for wireless adapters based on
	  MTK MT5931 chipset.

	  This driver uses the kernel's wireless extensions subsystem.

	  If you choose to build a module, it'll be called dhd. Say M if
	  unsure.

config MTK_MT5931_POWER_KK
	tristate "MT5931 power for android4.4"
	depends on MTK_MT5931_KK
	default y
	help
	  MT5931 power control
```

## drivers/power/wmt_battery/charger/mp2625/Kconfig
```kconfig
config MP2625_CHARGER
		tristate "MP2625 Charger driver"
		depends on I2C
		help
			Say Y here to enable support for charger with mp2625 chip.	  
```
